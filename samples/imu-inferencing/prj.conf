## CMakeLists.txt
```
cmake_minimum_required(VERSION 3.20.0)

set(CMAKE_CXX_STANDARD 11)
set(CMAKE_CXX_STANDARD_REQUIRED ON)

list(APPEND ZEPHYR_EXTRA_MODULES ${CMAKE_CURRENT_SOURCE_DIR}/model)

# This firmware uses X-Nucleo IKS02A1 shield
set(SHIELD x_nucleo_iks02a1)

find_package(Zephyr REQUIRED HINTS $ENV{ZEPHYR_BASE})

project(inference-example)

include(utils/cmake/utils.cmake)

# Needed for colorful output
zephyr_compile_options(-fdiagnostics-color=always)

# Project include directories
set(INCLUDES
    .
    src
    )
include_directories(${INCLUDES})

# add all sources to the project
target_sources(app PRIVATE src/main.cpp)
target_sources(app PRIVATE src/sensors/ei_accelerometer.cpp)
target_sources(app PRIVATE src/sensors/ei_inertial.cpp)
target_sources(app PRIVATE src/inference/inferencing.cpp)
```

## sample.yaml
```
sample:
  description: Run inference using one of the ST sensor hat
    application
  name: inference-example
common:
    tags: introduction
    harness: console
    harness_config:
      type: one_line
      regex:
        - "Edge Impulse start inferencing on Zephyr(.*)"
```

## west.yml
```
manifest:

  remotes:
    - name: zephyrproject-rtos
      url-base: https://github.com/zephyrproject-rtos

  projects:
    - name: zephyr
      remote:  zephyrproject-rtos
      repo-path: zephyr
      revision: main
      import: true

    - name: edge-impulse-sdk-zephyr
      description: Edge Impulse SDK for Zephyr
      path: modules/edge-impulse-sdk-zephyr
      revision: main
      url: https://github.com/edgeimpulse/edge-impulse-sdk-zephyr

  self:
    path: inference-example
```

## prj.conf
```kconfig
CONFIG_GPIO=y
# enable c++ support
CONFIG_CPP=y
CONFIG_GLIBCXX_LIBCPP=y
CONFIG_NEWLIB_LIBC=y
CONFIG_NEWLIB_LIBC_FLOAT_PRINTF=y
CONFIG_FPU=y

CONFIG_MAIN_STACK_SIZE=8192
CONFIG_CONSOLE_SUBSYS=y
CONFIG_CONSOLE_GETLINE=y

# Logging
CONFIG_LOG=y
CONFIG_ASSERT=y
CONFIG_LOG_PROCESS_THREAD_STACK_SIZE=1024

# Edge Impulse SDK
CONFIG_EDGE_IMPULSE_SDK=y
CONFIG_HEAP_MEM_POOL_SIZE=8192

################################################################################
# Debug configuration (logger using RTT)

# CONFIG_LOG2_MODE_DEFERRED=y
# CONFIG_USE_SEGGER_RTT=y
# CONFIG_SEGGER_RTT_BUFFER_SIZE_UP=4096
# CONFIG_LOG_BACKEND_RTT=y
# CONFIG_LOG_PRINTK=y

# Audio/PDM support
#CONFIG_I2S=y
#CONFIG_AUDIO=y
#CONFIG_AUDIO_DMIC=y

# Sensors on X-Nucleo IKS02A1
CONFIG_I2C=y
CONFIG_SENSOR=y
```

## src/main.cpp
```c
/* The Clear BSD License
 *
 * Copyright (c) 2025 EdgeImpulse Inc.
 * All rights reserved.
 *
 * Redistribution and use in source and binary forms, with or without
 * modification, are permitted (subject to the limitations in the disclaimer
 * below) provided that the following conditions are met:
 *
 *   * Redistributions of source code must retain the above copyright notice,
 *   this list of conditions and the following disclaimer.
 *
 *   * Redistributions in binary form must reproduce the above copyright
 *   notice, this list of conditions and the following disclaimer in the
 *   documentation and/or other materials provided with the distribution.
 *
 *   * Neither the name of the copyright holder nor the names of its
 *   contributors may be used to endorse or promote products derived from this
 *   software without specific prior written permission.
 *
 * NO EXPRESS OR IMPLIED LICENSES TO ANY PARTY'S PATENT RIGHTS ARE GRANTED BY
 * THIS LICENSE. THIS SOFTWARE IS PROVIDED BY THE COPYRIGHT HOLDERS AND
 * CONTRIBUTORS "AS IS" AND ANY EXPRESS OR IMPLIED WARRANTIES, INCLUDING, BUT NOT
 * LIMITED TO, THE IMPLIED WARRANTIES OF MERCHANTABILITY AND FITNESS FOR A
 * PARTICULAR PURPOSE ARE DISCLAIMED. IN NO EVENT SHALL THE COPYRIGHT HOLDER OR
 * CONTRIBUTORS BE LIABLE FOR ANY DIRECT, INDIRECT, INCIDENTAL, SPECIAL,
 * EXEMPLARY, OR CONSEQUENTIAL DAMAGES (INCLUDING, BUT NOT LIMITED TO,
 * PROCUREMENT OF SUBSTITUTE GOODS OR SERVICES; LOSS OF USE, DATA, OR PROFITS; OR
 * BUSINESS INTERRUPTION) HOWEVER CAUSED AND ON ANY THEORY OF LIABILITY, WHETHER
 * IN CONTRACT, STRICT LIABILITY, OR TORT (INCLUDING NEGLIGENCE OR OTHERWISE)
 * ARISING IN ANY WAY OUT OF THE USE OF THIS SOFTWARE, EVEN IF ADVISED OF THE
 * POSSIBILITY OF SUCH DAMAGE.
 */

#include <zephyr/kernel.h>
#include "sensors/ei_accelerometer.h"
#include "sensors/ei_inertial.h"
#include "inference/inferencing.h"
#include <stdio.h>

int main(void)
{
    
    // This is needed so that output of printf is output immediately without buffering
    setvbuf(stdout, NULL, _IONBF, 0);

    ei_inertial_init();
    ei_accelerometer_init();

    ei_inference_sm(); // run state machine

    return 0;
}
```
