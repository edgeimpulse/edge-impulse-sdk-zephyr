## CMakeLists.txt
```
cmake_minimum_required(VERSION 3.20.10)

set(CMAKE_CXX_STANDARD 11)
set(CMAKE_CXX_STANDARD_REQUIRED ON)

list(APPEND ZEPHYR_EXTRA_MODULES ${CMAKE_CURRENT_SOURCE_DIR}/model)

find_package(Zephyr REQUIRED HINTS $ENV{ZEPHYR_BASE})

project(example-standalone-inferencing-zephyr
    DESCRIPTION "Edge Impulse Standalone Inferencing Zephyr Example"
    VERSION 1.0.0
    LANGUAGES C CXX ASM
    )

include(utils/cmake/utils.cmake)

# Needed for colorful output
zephyr_compile_options(-fdiagnostics-color=always)

# Use hardware acceleration for DSP and Neural Network code
# You'll need to disable these on non-Arm cores
    add_definitions(-DEI_CLASSIFIER_TFLITE_ENABLE_CMSIS_NN=1
                    -DARM_MATH_LOOPUNROLL
                    )

# If using Nordic boards, add the following definition
# -DEI_NORDIC

# Edge impulse SDK include directories
set(INCLUDES
    .
    src
    )
include_directories(${INCLUDES})

# add all sources to the project
target_sources(app PRIVATE src/main.cpp)
```

## sample.yaml
```
sample:
  description: example-standalone-inferencing-zephyr-module, the simplest Edge Impulse example for Zephyr
    application
  name: example-standalone-inferencing-zephyr-module
common:
    tags: introduction
    harness: console
    harness_config:
      type: one_line
      regex:
        - "Edge Impulse standalone inferencing \\(Zephyr\\)(.*)"
```

## west.yml
```
manifest:

  remotes:
    - name: zephyrproject-rtos
      url-base: https://github.com/zephyrproject-rtos

  projects:
    - name: zephyr
      remote:  zephyrproject-rtos
      repo-path: zephyr
      revision: main
      import: true

    - name: edge-impulse-sdk-zephyr
      description: Edge Impulse SDK for Zephyr
      path: modules/edge-impulse-sdk-zephyr
      west-commands: west/west-commands.yml
      revision: main
      url: https://github.com/edgeimpulse/edge-impulse-sdk-zephyr

  self:
    path: example-standalone-inferencing-zephyr-module
```

## prj.conf
```kconfig
CONFIG_GPIO=y
# enable c++ support
CONFIG_CPP=y
CONFIG_GLIBCXX_LIBCPP=y
CONFIG_NEWLIB_LIBC=y
CONFIG_NEWLIB_LIBC_FLOAT_PRINTF=y
CONFIG_FPU=y

CONFIG_MAIN_STACK_SIZE=4096
CONFIG_CONSOLE_SUBSYS=y
CONFIG_CONSOLE_GETLINE=y

# Logging
CONFIG_LOG=y
CONFIG_ASSERT=y
CONFIG_LOG_PROCESS_THREAD_STACK_SIZE=1024

# Edge Impulse SDK
CONFIG_EDGE_IMPULSE_SDK=y
CONFIG_HEAP_MEM_POOL_SIZE=8192
################################################################################
# Debug configuration (logger using RTT)

# CONFIG_LOG2_MODE_DEFERRED=y
# CONFIG_USE_SEGGER_RTT=y
# CONFIG_SEGGER_RTT_BUFFER_SIZE_UP=4096
# CONFIG_LOG_BACKEND_RTT=y
# CONFIG_LOG_PRINTK=y
```

## src/main.cpp
```c
// Zephyr 3.1.x and newer uses different include scheme
#include <zephyr/version.h>
#if (KERNEL_VERSION_MAJOR > 3) || ((KERNEL_VERSION_MAJOR == 3) && (KERNEL_VERSION_MINOR >= 1))
#include <zephyr/kernel.h>
#else
#include <zephyr.h>
#endif
#include "edge-impulse-sdk/classifier/ei_run_classifier.h"
#include "edge-impulse-sdk/classifier/ei_print_results.h"
#include "edge-impulse-sdk/porting/ei_classifier_porting.h"
#include "edge-impulse-sdk/dsp/numpy.hpp"
#ifdef EI_NORDIC
#include <nrfx_clock.h>
#endif

static const float features[] = {
    // copy raw features here (for example from the 'Live classification' page)
    // see https://docs.edgeimpulse.com/docs/running-your-impulse-locally-zephyr
};

int raw_feature_get_data(size_t offset, size_t length, float *out_ptr) {
    memcpy(out_ptr, features + offset, length * sizeof(float));
    return 0;
}

int main() {
    // This is needed so that output of printf is output immediately without buffering
    setvbuf(stdout, NULL, _IONBF, 0);


#if (KERNEL_VERSION_MAJOR < 3)
#ifdef CONFIG_SOC_NRF5340_CPUAPP // this comes from Zephyr
    // Switch CPU core clock to 128 MHz (only for NCS < 3.0.0)
    nrfx_clock_divider_set(NRF_CLOCK_DOMAIN_HFCLK, NRF_CLOCK_HFCLK_DIV_1);
#endif
#endif

    printk("Edge Impulse standalone inferencing (Zephyr)\n");

    if (sizeof(features) / sizeof(float) != EI_CLASSIFIER_DSP_INPUT_FRAME_SIZE) {
        printk("The size of your 'features' array is not correct. Expected %d items, but had %u\n",
            EI_CLASSIFIER_DSP_INPUT_FRAME_SIZE, sizeof(features) / sizeof(float));
        return 1;
    }

    ei_impulse_result_t result = { 0 };

    while (1) {
        // the features are stored into flash, and we don't want to load everything into RAM
        signal_t features_signal;
        features_signal.total_length = sizeof(features) / sizeof(features[0]);
        features_signal.get_data = &raw_feature_get_data;

        // invoke the impulse
        EI_IMPULSE_ERROR res = run_classifier(&features_signal, &result, false);
        printk("run_classifier returned: %d\n", res);

        if (res != 0) return 1;

        ei_print_results(&ei_default_impulse, &result);
        
        k_msleep(2000);
    }
}
```
